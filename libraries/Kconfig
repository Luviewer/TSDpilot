## libraries/Kconfig
```kconfig
menu "Libraries Config"

menu "Libraries Examples Config"
    menuconfig LIBS_USING_EXAMPLES
    bool "USING_EXAMPLES"
    select RT_USING_EXAPMLES
    select RT_USING_MAIN
    default n
    if LIBS_USING_EXAMPLES
        choice
            prompt "Select examples"
            default LIBS_UART_SIMPLE_TEST

            config LIBS_UART_SIMPLE_TEST
                bool "LIBS_UART_SIMPLE_TEST"

            config LIBS_UAVCAN_SIMPLE_TEST
                bool "LIBS_UAVCAN_SIMPLE_TEST"
        endchoice
    endif
endmenu


endmenu
```

## platform/cuavv5plus/board/Kconfig
```kconfig
menu "Hardware Drivers Config"

config SOC_STM32F767IG
    bool
    select SOC_SERIES_STM32F7
    select RT_USING_COMPONENTS_INIT
    select RT_USING_USER_MAIN
    default y

menu "Onboard Peripheral Drivers"

    config BSP_USING_QSPI_FLASH
        bool "Enable QSPI FLASH (W25Q128 qspi1)"
        select BSP_USING_QSPI
        select RT_USING_SFUD
        select RT_SFUD_USING_QSPI
        default n
    
    config BSP_USING_SDCARD
        bool "Enable SDCARD (sdio)"
        select BSP_USING_SDIO
        select RT_USING_DFS
        select RT_USING_DFS_ELMFAT
        select RT_USING_PIN
        default n

endmenu

menu "On-chip Peripheral Drivers"

    config BSP_USING_GPIO
        bool "Enable GPIO"
        select RT_USING_PIN
        default y

    menuconfig BSP_USING_UART
        bool "Enable UART"
        default y
        select RT_USING_SERIAL
        if BSP_USING_UART
            config BSP_USING_UART1
                bool "Enable UART1"
                default y

            config BSP_UART1_RX_USING_DMA
                bool "Enable UART1 RX DMA"
                depends on BSP_USING_UART1 && RT_SERIAL_USING_DMA
                default n

            config BSP_USING_UART2
                bool "Enable UART2"
                default n

            config BSP_UART2_RX_USING_DMA
                bool "Enable UART2 RX DMA"
                depends on BSP_USING_UART2 && RT_SERIAL_USING_DMA
                default n

            config BSP_USING_UART3
                bool "Enable UART3"
                default n

            config BSP_UART3_RX_USING_DMA
                bool "Enable UART3 RX DMA"
                depends on BSP_USING_UART3 && RT_SERIAL_USING_DMA
                default n
        endif

    config BSP_USING_ON_CHIP_FLASH
        bool "Enable on-chip FLASH"
        default n

    config BSP_USING_QSPI
        bool "Enable QSPI BUS"
        select RT_USING_QSPI
        select RT_USING_SPI
        default n
        
    menuconfig BSP_USING_ADC
        bool "Enable ADC"
        default n
        select RT_USING_ADC
        if BSP_USING_ADC
            config BSP_USING_ADC1
                bool "Enable ADC1"
                default n
        endif

    menuconfig BSP_USING_I2C1
        bool "Enable I2C1 BUS (software simulation)"
        default n
        select RT_USING_I2C
        select RT_USING_I2C_BITOPS
        select RT_USING_PIN
        if BSP_USING_I2C1
            comment "Notice: PB6 --> 22; PB7 --> 23" 
            config BSP_I2C1_SCL_PIN
                int "I2C1 scl pin number"
                range 1 176
                default 22
            config BSP_I2C1_SDA_PIN
                int "I2C1 sda pin number"
                range 1 176
                default 23
        endif

    config BSP_USING_WDT
        bool "Enable Watchdog Timer"
        select RT_USING_WDT
        default n

    config BSP_USING_SDIO
        bool "Enable SDIO"
        select RT_USING_SDIO
        select RT_USING_DFS
        default n
    
    config BSP_USING_FMC
        bool
        default n

    config BSP_USING_LTDC
        bool
        default n

        config BSP_USING_USBD
        bool "Enable OTGFS as USB device"
        select RT_USING_USB_DEVICE
        select BSP_USBD_TYPE_FS
        default n

    source "../../modules/rt-thread/bsp/stm32/libraries/HAL_Drivers/Kconfig"
    
endmenu

menu "Board extended module Drivers"

endmenu

endmenu
```

## platform/cubeorange/Kconfig
```kconfig
mainmenu "RT-Thread Configuration"

config BSP_DIR
    string
    option env="BSP_ROOT"
    default "."

config RTT_DIR
    string
    option env="RTT_ROOT"
    default "../../modules/rt-thread"

config PKGS_DIR
    string
    option env="PKGS_ROOT"
    default "packages"


source "$RTT_DIR/Kconfig"
source "$PKGS_DIR/Kconfig"
source "../../modules/rt-thread/bsp/stm32/libraries/Kconfig"
source "board/Kconfig"
source "../../libraries/Kconfig"
```
